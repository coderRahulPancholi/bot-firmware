## sdkconfig.defaults
```kconfig
# Override some defaults so BT stack is enabled
CONFIG_BT_ENABLED=y
CONFIG_BT_NIMBLE_ENABLED=y

CONFIG_BLE_CONN_MGR_ROLE_PERIPHERAL=y
CONFIG_BLE_CTS=y
CONFIG_BLE_OTA_SVC=y

# Disable Brownout Detector to prevent boot loops on power spikes
CONFIG_ESP_BROWNOUT_DET=n
CONFIG_ESP32_BROWNOUT_DET=n
CONFIG_BROWNOUT_DET=n

# Custom Partition Table for OTA
CONFIG_PARTITION_TABLE_CUSTOM=y
CONFIG_PARTITION_TABLE_CUSTOM_FILENAME="partitions.csv"
CONFIG_PARTITION_TABLE_FILENAME="partitions.csv"
CONFIG_PARTITION_TABLE_OFFSET=0x8000
CONFIG_PARTITION_TABLE_MD5=y

# Set Flash Size to 4MB to accommodate the OTA partitions
CONFIG_ESPTOOLPY_FLASHSIZE_4MB=y
CONFIG_ESPTOOLPY_FLASHSIZE="4MB"
```
